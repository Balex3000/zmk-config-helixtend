## config/boards/shields/helixtend/Kconfig.shield
```kconfig
# Copyright (c) 2020 Pete Johanson
# SPDX-License-Identifier: MIT

config SHIELD_HELIXTEND_LEFT
	def_bool $(shields_list_contains,helixtend_left)

config SHIELD_HELIXTEND_RIGHT
	def_bool $(shields_list_contains,helixtend_right)
```
